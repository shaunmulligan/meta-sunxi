## conf/machine/orange-pi-lite.conf
```bitbake
#@TYPE: Machine
#@NAME: orange-pi-lite
#@DESCRIPTION: Machine configuration for the orange-pi-lite, base on allwinner H3 CPU

require conf/machine/include/sun8i.inc

PREFERRED_VERSION_linux = "4.11.0+git%"
PREFERRED_VERSION_u-boot = "v2017.03%"

KERNEL_DEVICETREE = "sun8i-h3-orangepi-lite.dtb"
UBOOT_MACHINE = "orangepi_lite_defconfig"

DEFAULTTUNE = "cortexa7hf-neon-vfpv4"
```

## conf/machine/orange-pi-plus2e.conf
```bitbake
#@TYPE: Machine
#@NAME: orange-pi-plus-2e
#@DESCRIPTION: Machine configuration for the orange-pi-plus-2e, base on allwinner H3 CPU

require conf/machine/include/sun8i.inc

PREFERRED_VERSION_linux = "4.11.0+git%"
PREFERRED_VERSION_u-boot = "v2017.03%"

KERNEL_DEVICETREE = "sun8i-h3-orangepi-plus2e.dtb"
UBOOT_MACHINE = "orangepi_plus2e_defconfig"

DEFAULTTUNE = "cortexa7hf-neon-vfpv4"
```
